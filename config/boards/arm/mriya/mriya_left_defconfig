## config/boards/arm/mriya/mriya_left_defconfig
```kconfig
# SPDX-License-Identifier: MIT

# SoC: Nordic nRF52840
CONFIG_SOC_SERIES_NRF52X=y
CONFIG_SOC_NRF52840_QIAA=y

# Board: left half, central role in split
CONFIG_BOARD_MRIYA_LEFT=y
CONFIG_ZMK_SPLIT=y
CONFIG_ZMK_SPLIT_ROLE_CENTRAL=y

# USB and BLE connectivity (USB has priority over BLE when both connected)
CONFIG_ZMK_USB=y
CONFIG_ZMK_BLE=y
# Max simultaneous BLE connections (peripherals + host devices)
CONFIG_BT_MAX_CONN=6
# Max saved BLE bonds
CONFIG_BT_MAX_PAIRED=6

# Faster BLE connection parameter negotiation (ms)
CONFIG_BT_CONN_PARAM_UPDATE_TIMEOUT=500

# Power management
# Enable deep sleep mode
CONFIG_ZMK_SLEEP=y
# Enter idle after 30s of inactivity
CONFIG_ZMK_IDLE_TIMEOUT=30000
# Enter deep sleep after 45min of inactivity
CONFIG_ZMK_IDLE_SLEEP_TIMEOUT=2700000
# Battery level report interval (seconds)
CONFIG_ZMK_BATTERY_REPORT_INTERVAL=1800

# Mouse/trackball/trackpad support
CONFIG_ZMK_POINTING=y
# Pixel-precise scrolling instead of discrete scroll steps
# CONFIG_ZMK_POINTING_SMOOTH_SCROLLING=y

# BLE transmit power +8 dBm (max for nRF52840) for stronger signal
CONFIG_BT_CTLR_TX_PWR_PLUS_8=y

# Memory protection unit
CONFIG_ARM_MPU=y

# GPIO support
CONFIG_GPIO=y

# Use devicetree code partition for firmware
CONFIG_USE_DT_CODE_PARTITION=y
# Build UF2 firmware file for drag-and-drop flashing
CONFIG_BUILD_OUTPUT_UF2=y

# Flash and NVS storage for persistent settings (bonds, etc.)
CONFIG_MPU_ALLOW_FLASH_WRITE=y
CONFIG_NVS=y
CONFIG_SETTINGS_NVS=y
CONFIG_FLASH=y
CONFIG_FLASH_PAGE_LAYOUT=y
CONFIG_FLASH_MAP=y
# Clock: use internal RC oscillator (no external crystal)
CONFIG_CLOCK_CONTROL_NRF=y
CONFIG_CLOCK_CONTROL_NRF_K32SRC_RC=y
```

## config/boards/labuut/mriya/board.yml
```yaml
boards:
  - name: mriya_left
    vendor: labuut
    socs:
      - name: nrf52840
        variants:
          - name: zmk
  - name: mriya_right
    vendor: labuut
    socs:
      - name: nrf52840
        variants:
          - name: zmk
```

## config/boards/labuut/mriya/mriya_left_nrf52840_zmk_defconfig
```kconfig
# SPDX-License-Identifier: MIT

CONFIG_ZMK_BOARD_COMPAT=y

CONFIG_ZMK_SPLIT=y
CONFIG_ZMK_SPLIT_ROLE_CENTRAL=y

CONFIG_ZMK_USB=y
CONFIG_ZMK_BLE=y
CONFIG_BT_MAX_CONN=6
CONFIG_BT_MAX_PAIRED=6

CONFIG_ZMK_SLEEP=y
CONFIG_ZMK_IDLE_TIMEOUT=30000
CONFIG_ZMK_IDLE_SLEEP_TIMEOUT=2700000
CONFIG_ZMK_BATTERY_REPORT_INTERVAL=1800

CONFIG_ZMK_POINTING=y
# CONFIG_ZMK_POINTING_SMOOTH_SCROLLING=y

# CONFIG_BT_CTLR_TX_PWR_PLUS_8=y

# Enable MPU
CONFIG_ARM_MPU=y

# enable GPIO
CONFIG_GPIO=y

CONFIG_USE_DT_CODE_PARTITION=y
CONFIG_BUILD_OUTPUT_UF2=y

CONFIG_MPU_ALLOW_FLASH_WRITE=y
CONFIG_NVS=y
CONFIG_SETTINGS_NVS=y
CONFIG_FLASH=y
CONFIG_FLASH_PAGE_LAYOUT=y
CONFIG_FLASH_MAP=y
CONFIG_CLOCK_CONTROL_NRF_K32SRC_RC=y
```
